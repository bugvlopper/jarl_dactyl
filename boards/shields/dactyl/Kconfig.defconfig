## boards/shields/dactyl/Kconfig.defconfig
```kconfig
if SHIELD_DACTYL_LEFT

config ZMK_KEYBOARD_NAME
	default "Jarl_dactyl"

config ZMK_SPLIT_ROLE_CENTRAL
	default y

config CONFIG_CLOCK_CONTROL_NRF_K32SRC_RC
	default y

endif

if SHIELD_DACTYL_LEFT || SHIELD_DACTYL_RIGHT

config ZMK_SPLIT
	default y

endif
```

## boards/shields/dactyl/Kconfig.shield
```kconfig
config SHIELD_DACTYL_LEFT
	def_bool $(shields_list_contain,dactyl_left)


config SHIELD_DACTYL_RIGHT
	def_bool $(shields_list_contain,dactyl_right)
```
